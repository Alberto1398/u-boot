## board/actions/s900_upgrade/Kconfig
```kconfig
if TARGET_S900_UPGRADE

config SYS_BOARD
	default "s900_upgrade"

config SYS_VENDOR
	default "actions"

config SYS_CONFIG_NAME
	default "s900_upgrade"

endif
```

## board/actions/s900_vr/Kconfig
```kconfig
if TARGET_S900_VR

config SYS_BOARD
	default "s900_vr"

config SYS_VENDOR
	default "actions"

config SYS_CONFIG_NAME
	default "s900_vr"

endif
```

## board/actions/s900vr_v3s_cp/Kconfig
```kconfig
if TARGET_S900VR_V3S_CP

config SYS_BOARD
	default "s900vr_v3s_cp"

config SYS_VENDOR
	default "actions"

config SYS_CONFIG_NAME
	default "s900vr_v3s_cp"

endif
```

## board/actions/s900vr_ys_2k/Kconfig
```kconfig
if TARGET_S900VR_YS_2K

config SYS_BOARD
	default "s900vr_ys_2k"

config SYS_VENDOR
	default "actions"

config SYS_CONFIG_NAME
	default "s900vr_ys_2k"

endif
```

## board/actions/v700_cxvr/Kconfig
```kconfig
if TARGET_V700_CXVR

config SYS_BOARD
	default "v700_cxvr"

config SYS_VENDOR
	default "actions"

config SYS_CONFIG_NAME
	default "v700_cxvr"

endif
```

## board/actions/v700_gb7_nibiru/Kconfig
```kconfig
if TARGET_V700_GB7_NIBIRU

config SYS_BOARD
	default "v700_gb7_nibiru"

config SYS_VENDOR
	default "actions"

config SYS_CONFIG_NAME
	default "v700_gb7_nibiru"

endif
```

## board/actions/v700_qcb/Kconfig
```kconfig
if TARGET_V700_QCB

config SYS_BOARD
	default "v700_qcb"

config SYS_VENDOR
	default "actions"

config SYS_CONFIG_NAME
	default "v700_qcb"

endif
```

## drivers/rtc/Kconfig
```kconfig
config DM_RTC
	bool "Enable Driver Model for RTC drivers"
	depends on DM
	help
	  Enable drver model for real-time-clock drivers. The RTC uclass
	  then provides the rtc_get()/rtc_set() interface, delegating to
	  drivers to perform the actual functions. See rtc.h for a
	  description of the API.

config DM_PMIC_ATC260X_MFD_RTC
	bool "ATX260X multiple function device"
	depends on DM_PMIC
	default y
	help
	  ATX260X multiple function device misc rtc.
```
