## arch/arm/mach-owl/Kconfig
```kconfig
if ARCH_OWL

choice
	prompt "Actions OWL SoC select"
	optional

config S900
	bool "S900 family"
	select ARM64

config S700
	bool "S700 family"
	select ARM64
endchoice

config SYS_SOC
	default "owl"

config SYS_MALLOC_F_LEN
	default 0x800

source "arch/arm/mach-owl/s900/Kconfig"
source "arch/arm/mach-owl/s700/Kconfig"

endif
```

## arch/arm/mach-owl/s700/Kconfig
```kconfig
if S700

choice
	prompt "S700 board select"
	optional

	config TARGET_S700_GB7_WXGA
	bool "Actions S700 gb7_wxga board: storage emmc"

config TARGET_S700_ROSEAPPLEPI
	bool "Actions S700 gb7_roseapplepi board: storage emmc"

config TARGET_S700_EVB
	bool "Actions S700 evb board: storage emmc/nand"

config TARGET_S700_CB6
	bool "Actions S700_cb6 board: storage emmc/nand"

config TARGET_S700_CB7
	bool "Actions S700_cb7 board: storage emmc/nand"

config TARGET_S700_QCB
	bool "Actions S700_QCB board: storage emmc/nand"

config TARGET_GT7_EBOX
	bool "Actions GT7 EBOX board: emmc/nand"

config TARGET_GT7_EBOX_CTS
	bool "Actions GT7 EBOX_CTS board: emmc/nand"

config TARGET_GT7_EBOX_M8S_CTS
	bool "Actions GT7 EBOX_M8S_CTS board: emmc/nand"

config TARGET_GT7_EBOX_M8S
	bool "Actions GT7 EBOX M8S board: emmc/nand"

config TARGET_GT7_QCB
	bool "Actions GT7 QCB board: emmc/nand"
config TARGET_S700_UPGRADE
	bool "Actions S700 upgrade"
	help
	  Directly jump kernel/initramfs that already download to ddr by
	  production tool. Only used for burn firmware.

config TARGET_S700_ROSEAPPLEPI_UPGRADE
	bool "Actions S700 roseapplepi upgrade"
	help
	  Directly jump kernel/initramfs that already download to ddr by
	  production tool. Only used for burn firmware.

config TARGET_GT7_UPGRADE
	bool "Actions GT7 upgrade"
	help
	  Directly jump kernel/initramfs that already download to ddr by
	  production tool. Only used for burn firmware.

config TARGET_V700_GB7_NIBIRU
	bool "Actions V700 GB7 NIBIRU board: emmc/nand"

config TARGET_V700_CXVR
	bool "Actions V700 CXVR board: emmc/nand"

config TARGET_V700_QCB
	bool "Actions V700 QCB board: emmc/nand"

endchoice

source "board/actions/s700_gb7_wxga/Kconfig"
source "board/actions/s700_roseapplepi/Kconfig"
source "board/actions/s700_evb/Kconfig"
source "board/actions/s700_upgrade/Kconfig"
source "board/actions/s700_roseapplepi_upgrade/Kconfig"
source "board/actions/s700_cb6/Kconfig"
source "board/actions/s700_cb7/Kconfig"
source "board/actions/s700_qcb/Kconfig"
source "board/actions/gt7_ebox/Kconfig"
source "board/actions/gt7_upgrade/Kconfig"
source "board/actions/gt7_ebox_m8s/Kconfig"
source "board/actions/gt7_qcb/Kconfig"
source "board/actions/gt7_ebox_cts/Kconfig"
source "board/actions/gt7_ebox_m8s_cts/Kconfig"
source "board/actions/v700_gb7_nibiru/Kconfig"
source "board/actions/v700_cxvr/Kconfig"
source "board/actions/v700_qcb/Kconfig"

endif
```

## arch/arm/mach-owl/s900/Kconfig
```kconfig
if S900

choice
	prompt "S900 board select"
	optional

config TARGET_S900_EVB
	bool "Actions S900 evaluate board"

config TARGET_S900_UPGRADE
	bool "Actions S900 upgrade"
	help
	  Directly jump kernel/initramfs that already download to ddr by
	  production tool. Only used for burn firmware.
	  
config TARGET_S900_EVB_216BALL
	bool "Actions S900 EVB 216BALL"
	help
	  Directly jump kernel/initramfs that already download to ddr by
	  production tool. Only used for burn firmware.


config TARGET_S900_EVB2_EMMC
	bool "Actions S900 EVB2 (EMMC)"
	help
	  Directly jump kernel/initramfs that already download to ddr by
	  production tool. Only used for burn firmware.
config TARGET_GT9_EBOX
	bool "Actions GT9 EBOX"
	help
	  Directly jump kernel/initramfs that already download to ddr by
	  production tool. Only used for burn firmware.
	  
config TARGET_S900_96BOARD
	bool "Actions S900 96BOARD"
	help
	  Directly jump kernel/initramfs that already download to ddr by
	  production tool. Only used for burn firmware.
	  
config TARGET_S900_TPE
	bool "Actions S900 TPE"
	help
	  Directly jump kernel/initramfs that already download to ddr by
	  production tool. Only used for burn firmware.

config TARGET_S900_VR
	bool "Actions S900 VR"
	help
	  Directly jump kernel/initramfs that already download to ddr by
	  production tool. Only used for burn firmware.
	  
config TARGET_S900_EVB_MMC_BOOT
	bool "Actions S900 card burn"
	help
	  Directly jump kernel/initramfs that already download to ddr by
	  production tool. Only used for burn firmware.
	
config TARGET_S900_96BOARD_MMC_BOOT
	bool "Actions S900 96BOARD card burn"
	help
	  Directly jump kernel/initramfs that already download to ddr by
	  production tool. Only used for burn firmware.
	  

config TARGET_S900_EVB_216BALL_MMC_BOOT
	bool "Actions S900 EVB 216BALL card burn"
	help
	  Directly jump kernel/initramfs that already download to ddr by
	  production tool. Only used for burn firmware.

config TARGET_S900_RY_VR
	bool "Actions S900 RY VR"
	help
	  Directly jump kernel/initramfs that already download to ddr by
	  production tool. Only used for burn firmware.	 

config TARGET_S900VR_V3S_CP
	bool "Actions S900 V3S_CP"
	help
	  Directly jump kernel/initramfs that already download to ddr by
	  production tool. Only used for burn firmware.

config TARGET_S900VR_YS_2K
	bool "Actions S900 Yashi 2K"
	help
	  Directly jump kernel/initramfs that already download to ddr by
	  production tool. Only used for burn firmware.

endchoice

source "board/actions/s900_evb/Kconfig"
source "board/actions/s900_upgrade/Kconfig"
source "board/actions/s900_evb_216ball/Kconfig"
source "board/actions/gt9_ebox/Kconfig"
source "board/actions/s900_96board/Kconfig"
source "board/actions/s900_tpe/Kconfig"
source "board/actions/s900_vr/Kconfig"
source "board/actions/s900_mmc_boot/Kconfig"
source "board/actions/s900_RY_VR/Kconfig"
source "board/actions/s900vr_v3s_cp/Kconfig"
source "board/actions/s900vr_ys_2k/Kconfig"
source "board/actions/s900_evb2/Kconfig"
endif
```

## board/actions/gt7_ebox/Kconfig
```kconfig
if TARGET_GT7_EBOX

config SYS_BOARD
	default "gt7_ebox"

config SYS_VENDOR
	default "actions"

config SYS_CONFIG_NAME
	default "gt7_ebox"

endif
```

## board/actions/gt7_ebox_cts/Kconfig
```kconfig
if TARGET_GT7_EBOX_CTS

config SYS_BOARD
	default "gt7_ebox_cts"

config SYS_VENDOR
	default "actions"

config SYS_CONFIG_NAME
	default "gt7_ebox_cts"

endif
```

## board/actions/gt7_ebox_m8s/Kconfig
```kconfig
if TARGET_GT7_EBOX_M8S

config SYS_BOARD
	default "gt7_ebox_m8s"

config SYS_VENDOR
	default "actions"

config SYS_CONFIG_NAME
	default "gt7_ebox_m8s"

endif
```

## board/actions/gt7_ebox_m8s_cts/Kconfig
```kconfig
if TARGET_GT7_EBOX_M8S_CTS

config SYS_BOARD
	default "gt7_ebox_m8s_cts"

config SYS_VENDOR
	default "actions"

config SYS_CONFIG_NAME
	default "gt7_ebox_m8s_cts"

endif
```

## board/actions/gt7_qcb/Kconfig
```kconfig
if TARGET_GT7_QCB

config SYS_BOARD
	default "gt7_qcb"

config SYS_VENDOR
	default "actions"

config SYS_CONFIG_NAME
	default "gt7_qcb"

endif
```

## board/actions/gt7_upgrade/Kconfig
```kconfig
if TARGET_GT7_UPGRADE

config SYS_BOARD
	default "gt7_upgrade"

config SYS_VENDOR
	default "actions"

config SYS_CONFIG_NAME
	default "gt7_upgrade"

endif
```

## board/actions/gt9_ebox/Kconfig
```kconfig
if TARGET_GT9_EBOX

config SYS_BOARD
	default "gt9_ebox"

config SYS_VENDOR
	default "actions"

config SYS_CONFIG_NAME
	default "gt9_ebox"

endif
```

## board/actions/s700_cb6/Kconfig
```kconfig
if TARGET_S700_CB6

config SYS_BOARD
	default "s700_cb6"

config SYS_VENDOR
	default "actions"

config SYS_CONFIG_NAME
	default "s700_cb6"

endif
```

## board/actions/s700_cb7/Kconfig
```kconfig
if TARGET_S700_CB7

config SYS_BOARD
	default "s700_cb7"

config SYS_VENDOR
	default "actions"

config SYS_CONFIG_NAME
	default "s700_cb7"

endif
```

## board/actions/s700_evb/Kconfig
```kconfig
if TARGET_S700_EVB

config SYS_BOARD
	default "s700_evb"

config SYS_VENDOR
	default "actions"

config SYS_CONFIG_NAME
	default "s700_evb"

endif
```

## board/actions/s700_gb7_wxga/Kconfig
```kconfig
if TARGET_S700_GB7_WXGA

config SYS_BOARD
	default "s700_gb7_wxga"

config SYS_VENDOR
	default "actions"

config SYS_CONFIG_NAME
	default "s700_gb7_wxga"

endif
```

## board/actions/s700_qcb/Kconfig
```kconfig
if TARGET_S700_QCB

config SYS_BOARD
	default "s700_qcb"

config SYS_VENDOR
	default "actions"

config SYS_CONFIG_NAME
	default "s700_qcb"

endif
```

## board/actions/s700_roseapplepi/Kconfig
```kconfig
if TARGET_S700_ROSEAPPLEPI

config SYS_BOARD
	default "s700_roseapplepi"

config SYS_VENDOR
	default "actions"

config SYS_CONFIG_NAME
	default "s700_roseapplepi"

endif
```

## board/actions/s700_roseapplepi_upgrade/Kconfig
```kconfig
if TARGET_S700_ROSEAPPLEPI_UPGRADE

config SYS_BOARD
	default "s700_roseapplepi_upgrade"

config SYS_VENDOR
	default "actions"

config SYS_CONFIG_NAME
	default "s700_roseapplepi_upgrade"

endif
```

## board/actions/s700_upgrade/Kconfig
```kconfig
if TARGET_S700_UPGRADE

config SYS_BOARD
	default "s700_upgrade"

config SYS_VENDOR
	default "actions"

config SYS_CONFIG_NAME
	default "s700_upgrade"

endif
```

## board/actions/s900_96board/Kconfig
```kconfig
if TARGET_S900_96BOARD

config SYS_BOARD
	default "s900_96board"

config SYS_VENDOR
	default "actions"

config SYS_CONFIG_NAME
	default "s900_96board"

endif
```

## board/actions/s900_RY_VR/Kconfig
```kconfig
if TARGET_S900_RY_VR

config SYS_BOARD
	default "s900_RY_VR"

config SYS_VENDOR
	default "actions"

config SYS_CONFIG_NAME
	default "s900_RY_VR"

endif
```

## board/actions/s900_evb/Kconfig
```kconfig
if TARGET_S900_EVB

config SYS_BOARD
	default "s900_evb"

config SYS_VENDOR
	default "actions"

config SYS_CONFIG_NAME
	default "s900_evb"

endif
```

## board/actions/s900_evb2/Kconfig
```kconfig
if TARGET_S900_EVB2_EMMC
config SYS_BOARD
	default "s900_evb2"

config SYS_VENDOR
	default "actions"

config SYS_CONFIG_NAME
	default "s900_evb2_emmc"
endif

if TARGET_S900_EVB2_NAND
config SYS_BOARD
	default "s900_evb2"

config SYS_VENDOR
	default "actions"

config SYS_CONFIG_NAME
	default "s900_evb2_nand"
endif
```

## board/actions/s900_evb_216ball/Kconfig
```kconfig
if TARGET_S900_EVB_216BALL

config SYS_BOARD
	default "s900_evb_216ball"

config SYS_VENDOR
	default "actions"

config SYS_CONFIG_NAME
	default "s900_evb_216ball"

endif
```

## board/actions/s900_mmc_boot/Kconfig
```kconfig
if TARGET_S900_EVB_MMC_BOOT

config SYS_BOARD
	default "s900_mmc_boot"

config SYS_VENDOR
	default "actions"

config SYS_CONFIG_NAME
	default "s900_evb_mmc_boot"

endif

if TARGET_S900_EVB_216BALL_MMC_BOOT

config SYS_BOARD
	default "s900_mmc_boot"

config SYS_VENDOR
	default "actions"

config SYS_CONFIG_NAME
	default "s900_evb_216ball_mmc_boot"

endif

if TARGET_S900_96BOARD_MMC_BOOT

config SYS_BOARD
	default "s900_mmc_boot"

config SYS_VENDOR
	default "actions"

config SYS_CONFIG_NAME
	default "s900_96board_mmc_boot"

endif
```

## board/actions/s900_tpe/Kconfig
```kconfig
if TARGET_S900_TPE

config SYS_BOARD
	default "s900_tpe"

config SYS_VENDOR
	default "actions"

config SYS_CONFIG_NAME
	default "s900_tpe"

endif
```
